#include <GyverHub.h>
GyverHub hub("MyDevices", "SmartHouseM3", "");  // можно настроить тут, но без F-строк!
// Задаем статический IP-адрес:
IPAddress local_IP(192, 168, 4, 19);
// Задаем IP-адрес сетевого шлюза:
IPAddress gateway(192, 168, 1, 1);
IPAddress subnet(255, 255, 0, 0);
#include <EEPROM.h>
#define EEPROM_SIZE 100

char* AP_SSID;
int number = 0;

bool flagDor, flagWindow, flagWind, flagWhite, led, flagLCD, flagLight, logoF;
int light, hum, temp;

const byte picture[] PROGMEM = {  // картинка
  0x00, 0x00, 0x00, 0x00, 0x00, 0x00, 0x00, 0x00, 0x00, 0x00, 0x00, 0x00, 0x00, 0x00, 0x00, 0x00,
  0x00, 0x00, 0x00, 0x00, 0x00, 0x00, 0x00, 0x00, 0x00, 0x00, 0x00, 0x00, 0x00, 0x00, 0x00, 0x00,
  0x00, 0x00, 0x00, 0x00, 0x00, 0x00, 0x00, 0x00, 0x00, 0x00, 0x00, 0x00, 0x00, 0x00, 0x00, 0x00,
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  0x00, 0x00, 0x00, 0x00, 0x00, 0x00, 0x00, 0x00, 0x00, 0x00, 0x00, 0x00, 0x00, 0x00, 0x00, 0x00
};

#include <ESP32_Servo.h>
Servo window;
Servo gates;
// в файлах проекта показано, как настроить углы
#define OPENED_GATES 70
#define CLOSED_GATES 30
#define OPENED_WINDOW 30
#define CLOSED_WINDOW 70

#define WHITE_LED 17
#define WIND 16
#define BUTTON 19  // пин для подключения
int buttonState;   // переменная для хранения состояния кнопки

#include <Wire.h>

#include <I2C_graphical_LCD_display.h>
I2C_graphical_LCD_display lcd;

#include <BH1750.h>
BH1750 lightMeter;

#include <Adafruit_Sensor.h>
#include <Adafruit_BME280.h>
Adafruit_BME280 bme280;

// билдер
void build(gh::Builder& b) {
  {
    gh::Row r(b);
    if (b.SwitchIcon_("SwDoor", &flagDor).icon("f52a").label("Управление окном").click()) {
      if (flagDor) {
        window.write(OPENED_WINDOW);
        hub.update("SwDoor").icon("f52b");
      } else {
        window.write(CLOSED_WINDOW);
        hub.update("SwDoor").icon("f52a");
      }
    }
    if (b.SwitchIcon_("SwWindow", &flagWindow).icon("f023").label("Управление воротами").click()) {
      if (flagWindow) {
        gates.write(OPENED_GATES);
        hub.update("SwWindow").icon("f3c1");
      } else {
        gates.write(CLOSED_GATES);
        hub.update("SwWindow").icon("f023");
      }
    }
  }

  {
    gh::Row r(b);
    if (b.SwitchIcon_("SwWind", &flagWind).icon("f863").label("Управление вентилятором").click()) {
      if (flagWind) {
        hub.update("SwWind").icon("f863").color(0x37A93C);
      } else {
        hub.update("SwWind").icon("f863").color(0x000000);
      }
      digitalWrite(WIND, flagWind);
    }
    if (b.SwitchIcon_("SwWhite", &flagWhite).icon("f863").label("Управление светом").click()) {
      if (flagWhite) {
        hub.update("SwWhite").icon("f863").color(0x37A93C);
      } else {
        hub.update("SwWhite").icon("f863").color(0x000000);
      }
      digitalWrite(WHITE_LED, flagWhite);
    }
    b.Icon_("Butt").icon("f0f3").label("Кнопка (звонок)").color(0x000000);
  }

  {
    gh::Row r(b);
    if (b.Switch(&logoF).label("Лого").click()) {
      setBusChannel(0x04);
      if (logoF) {
        lcd.clear(0, 0, 128, 64, 0x00);  // очищаем поле дисплея
        lcd.blit(picture, sizeof picture);
        delay(1500);
        Serial.println("Logo MGBot выведено на экран!");
      } else {
        lcd.clear(0, 0, 128, 64, 0x00);  // очищаем поле дисплея
        Serial.println("Logo MGBot отключено!");
      }
    }
  }

  {
    gh::Row r(b);
    b.Label_("Temp").label("Температура");
    b.Label_("Hum").label("Влажность");
    b.Label_("light").label("Освещенность");
  }
}

void setup() {
  startup();
  if (!LittleFS.begin()) Serial.println("FS Error");

  Serial.begin(115200);
  window.attach(4);
  gates.attach(13);

  pinMode(WHITE_LED, OUTPUT);
  pinMode(WIND, OUTPUT);
  pinMode(BUTTON, INPUT);

  Wire.begin();

  setBusChannel(0x04);
  lcd.begin();
  lcd.gotoxy(10, 50);  // координата курсора
  lcd.string("Privet, MGBOT!", false);

  setBusChannel(0x04);
  lightMeter.begin();

  bool bme_status = bme280.begin();
  if (!bme_status) {
    Serial.println("Не найден по адресу 0х77, пробую другой...");
    bme_status = bme280.begin(0x76);
    if (!bme_status)
      Serial.println("Датчик не найден, проверьте соединение");
  }

  // подключить билдер
  hub.onBuild(build);

  // запуск!
  hub.begin();
}

void loop() {
  // =================== ТИКЕР ===================
  // вызываем тикер в главном цикле программы
  // он обеспечивает работу связи, таймаутов и прочего
  hub.tick();

  // =========== ОБНОВЛЕНИЯ ПО ТАЙМЕРУ ===========
  // в библиотеке предусмотрен удобный класс асинхронного таймера
  static gh::Timer tmr(1000);  // период 1 секунда

  // каждую секунду будем обновлять заголовок
  if (tmr) {
    //Собираем показания датчиков
    setBusChannel(0x04);
    light = lightMeter.readLightLevel();
    Serial.println(String(light) + " lx");
    temp = bme280.readTemperature();
    Serial.println("Air temperature = " + String(temp) + " *C");
    hum = bme280.readHumidity();
    Serial.println("Air humidity = " + String(hum) + " %");
    hub.update("Temp").value(temp);
    hub.update("Hum").value(hum);
    hub.update("light").value(light);

    static bool Button;
    Button = digitalRead(BUTTON);
    Serial.println("Button: " + String(Button));
    if (Button) {
      hub.update("Butt").color(0x000000).value(&Button);
    } else {
      hub.update("Butt").color(0x37A93C).value(&Button);
    }
    if (logoF == false) {
      lcd.clear(0, 0, 128, 64, 0x00);       // очищаем поле дисплея
      lcd.gotoxy(40, 53);                   // устанавливаем курсор в координату (40,53)
      lcd.string("Temperature, C", false);  // пишем фразу для температуры
      char buf[8];                          // создаем переменную типа char
      sprintf(buf, "%d", (int)temp);        // отправляем в нее данные о температуре
      lcd.clear(10, 53, 32, 60, 0x00);      // очищаем место под данные
      lcd.gotoxy(10, 53);                   // устанавливаем курсор в координату (10,53)
      lcd.string(buf, false);               // Пишем значение температуры
      lcd.gotoxy(40, 39);                   // устанавливаем курсор в координату (40,39)
      lcd.string("Humidity, %", false);     // пишем фразу для влажности
      char buf1[8];                         // создаем переменную типа char
      sprintf(buf1, "%d", (int)hum);        // отправляем в нее данные о влажности
      lcd.clear(10, 39, 32, 46, 0x00);      // очищаем место под данные
      lcd.gotoxy(10, 39);                   // устанавливаем курсор в координату (10,39)
      lcd.string(buf1, false);              // Пишем значение температуры
      lcd.gotoxy(40, 22);                   // устанавливаем курсор в координату (40,22)
      lcd.string("Lightning, lx", false);   // пишем фразу для давления
      char buf2[8];                         // создаем переменную типа char
      sprintf(buf2, "%d", (int)light);      // отправляем в нее данные о давлении
      lcd.clear(10, 22, 32, 32, 0x00);      // очищаем место под данные
      lcd.gotoxy(10, 22);                   // устанавливаем курсор в координату (10,22)
      lcd.string(buf2, false);              // Пишем значение давления
    }
  }
}

bool setBusChannel(uint8_t i2c_channel) {
  if (i2c_channel >= 0x08) {
    return false;
  } else {
    Wire.beginTransmission(0x70);
    //Wire.write(i2c_channel | 0x08);  // для микросхемы PCA9547
    Wire.write(0x01 << i2c_channel);  // Для микросхемы PW548A*/
    Wire.endTransmission();
    return true;
  }
}

void startup() {
  Serial.begin(115200);
  EEPROM.begin(EEPROM_SIZE);
  //EEPROM.put(95, number);  //Раскоментить для смены имени сети каждую перезагрузку
  //EEPROM.commit();
  checkNamber();

  WiFi.mode(WIFI_AP);
  Serial.print("Устанавливаем статический IP ---> ");
  Serial.println(WiFi.softAPConfig(local_IP, gateway, subnet) ? "Ready" : "Failed!");
  WiFi.softAP(AP_SSID, "");
  Serial.print("WiFi : ");
  Serial.println(AP_SSID);
  Serial.println(WiFi.softAPIP());
}

void checkNamber() {
  EEPROM.get(95, number);
  Serial.println(number);
  if (number == -1) {
    number = random(10000);
    EEPROM.put(95, number);
    EEPROM.commit();
  }

  String n = "SmartHouse_№-";
  n = n + String(number);

  AP_SSID = strcpy(new char[n.length() + 1], n.c_str());
}
